#include <Arduino.h>
#include <WiFi.h>
#include <WiFiClientSecure.h>
#include <HTTPClient.h>
#include <ArduinoJson.h>
#include <TFT_eSPI.h>
#include <time.h>
#include "secrets.h"
#include "weather_service.h"
#include "weather_types.h"

namespace
{
    constexpr const char *kServerHost = "api.openweathermap.org";
    constexpr uint16_t kServerPort = 443;
    // =========================================================================
    // Bitmap icons (from user-provided monolithic source) — 64x64 monochrome
    // =========================================================================

    // Fixed Clear / Sunny Icon
    const unsigned char bitmap_sunny_64[] PROGMEM = {
        0x00, 0x00, 0x00, 0x18, 0x18, 0x00, 0x00, 0x00,
        0x00, 0x00, 0x00, 0x18, 0x18, 0x00, 0x00, 0x00,
        0x00, 0x00, 0x00, 0x18, 0x18, 0x00, 0x00, 0x00,
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        0x00, 0x00, 0x00, 0x00, 0x00, 0x00, 0x00, 0x00};

    void drawMoonIcon(int x, int y, int newW, int newH, uint16_t color)
    {
        const int diameter = min(newW, newH);
        const int radius = diameter / 2;
        const int centerX = x + (newW / 2);
        const int centerY = y + (newH / 2);
        const int cutoutOffset = max(6, diameter / 5);
        const int cutoutRadius = max(4, radius - (diameter / 8));

        tft.fillCircle(centerX, centerY, radius, color);
        tft.fillCircle(centerX + cutoutOffset, centerY - cutoutOffset, cutoutRadius, TFT_BLACK);
    }

    void drawThickLine(int x0, int y0, int x1, int y1, int thickness, uint16_t color)
    {
        const int halfThickness = max(1, thickness / 2);
        const int deltaX = abs(x1 - x0);
        const int deltaY = abs(y1 - y0);

        for (int offset = -halfThickness; offset <= halfThickness; ++offset)
        {
            if (deltaX >= deltaY)
            {
                tft.drawLine(x0, y0 + offset, x1, y1 + offset, color);
            }
            else
            {
                tft.drawLine(x0 + offset, y0, x1 + offset, y1, color);
            }
        }
    }

    void drawSunIcon(int x, int y, int newW, int newH, uint16_t color)
    {
        const int diameter = min(newW, newH);
        const int centerX = x + (newW / 2);
        const int centerY = y + (newH / 2);
        const int coreRadius = diameter / 4;
        const int rayInner = coreRadius + max(4, diameter / 14);
        const int rayOuter = (diameter / 2) - max(4, diameter / 12);
        const int rayThickness = max(2, diameter / 16);
        const int diagonalInner = max(1, (rayInner * 7) / 10);
        const int diagonalOuter = max(diagonalInner + 1, (rayOuter * 7) / 10);

        tft.fillCircle(centerX, centerY, coreRadius, color);
        tft.fillRoundRect(centerX - (rayThickness / 2), centerY - rayOuter, rayThickness, rayOuter - rayInner, rayThickness / 2, color);
        tft.fillRoundRect(centerX - (rayThickness / 2), centerY + rayInner, rayThickness, rayOuter - rayInner, rayThickness / 2, color);
        tft.fillRoundRect(centerX - rayOuter, centerY - (rayThickness / 2), rayOuter - rayInner, rayThickness, rayThickness / 2, color);
        tft.fillRoundRect(centerX + rayInner, centerY - (rayThickness / 2), rayOuter - rayInner, rayThickness, rayThickness / 2, color);
        drawThickLine(centerX - diagonalInner, centerY - diagonalInner, centerX - diagonalOuter, centerY - diagonalOuter, rayThickness, color);
        drawThickLine(centerX + diagonalInner, centerY - diagonalInner, centerX + diagonalOuter, centerY - diagonalOuter, rayThickness, color);
        drawThickLine(centerX - diagonalInner, centerY + diagonalInner, centerX - diagonalOuter, centerY + diagonalOuter, rayThickness, color);
        drawThickLine(centerX + diagonalInner, centerY + diagonalInner, centerX + diagonalOuter, centerY + diagonalOuter, rayThickness, color);
    }

    void drawCloudIcon(int x, int y, int newW, int newH, uint16_t color)
    {
        const int centerX = x + (newW / 2);
        const int baseY = y + ((newH * 58) / 100);
        const int baseWidth = (newW * 72) / 100;
        const int baseHeight = max(12, (newH * 22) / 100);
        const int baseX = centerX - (baseWidth / 2);
        const int radiusLarge = max(12, newH / 5);
        const int radiusMedium = max(10, newH / 6);
        const int radiusSmall = max(8, newH / 7);

        tft.fillCircle(centerX - (newW / 5), baseY, radiusMedium, color);
        tft.fillCircle(centerX, baseY - (newH / 10), radiusLarge, color);
        tft.fillCircle(centerX + (newW / 5), baseY, radiusSmall, color);
        tft.fillRoundRect(baseX, baseY, baseWidth, baseHeight, baseHeight / 2, color);
    }

    void drawRainIcon(int x, int y, int newW, int newH, uint16_t color)
    {
        const int cloudHeight = (newH * 58) / 100;
        const int dropTop = y + cloudHeight;
        const int dropLength = max(10, newH / 5);
        const int dropThickness = max(2, newW / 24);
        const int leftX = x + (newW * 26) / 100;
        const int midX = x + (newW * 50) / 100;
        const int rightX = x + (newW * 74) / 100;

        drawCloudIcon(x, y, newW, cloudHeight, TFT_LIGHTGREY);
        drawThickLine(leftX, dropTop, leftX - (newW / 18), dropTop + dropLength, dropThickness, color);
        drawThickLine(midX, dropTop + (newH / 18), midX - (newW / 18), dropTop + dropLength + (newH / 18), dropThickness, color);
        drawThickLine(rightX, dropTop, rightX - (newW / 18), dropTop + dropLength, dropThickness, color);
    }

    void drawWindIcon(int x, int y, int newW, int newH, uint16_t color)
    {
        const int lineThickness = max(6, newH / 10);
        const int firstY = y + (newH * 32) / 100;
        const int secondY = y + (newH * 50) / 100;
        const int thirdY = y + (newH * 68) / 100;
        const int firstX = x + (newW * 12) / 100;
        const int secondX = x + (newW * 22) / 100;
        const int thirdX = x + (newW * 8) / 100;
        const int firstW = (newW * 64) / 100;
        const int secondW = (newW * 52) / 100;
        const int thirdW = (newW * 72) / 100;

        tft.fillRoundRect(firstX, firstY, firstW, lineThickness, lineThickness / 2, color);
        tft.fillRoundRect(secondX, secondY, secondW, lineThickness, lineThickness / 2, color);
        tft.fillRoundRect(thirdX, thirdY, thirdW, lineThickness, lineThickness / 2, color);
        tft.fillCircle(firstX + firstW, firstY + (lineThickness / 2), lineThickness / 2, color);
        tft.fillCircle(secondX + secondW, secondY + (lineThickness / 2), lineThickness / 2, color);
        tft.fillCircle(thirdX + thirdW, thirdY + (lineThickness / 2), lineThickness / 2, color);
        tft.fillCircle(firstX + firstW + (lineThickness / 3), firstY + (lineThickness / 2), lineThickness / 2, TFT_BLACK);
        tft.fillCircle(secondX + secondW + (lineThickness / 3), secondY + (lineThickness / 2), lineThickness / 2, TFT_BLACK);
        tft.fillCircle(thirdX + thirdW + (lineThickness / 3), thirdY + (lineThickness / 2), lineThickness / 2, TFT_BLACK);
    }

    void drawStormIcon(int x, int y, int newW, int newH)
    {
        const int cloudHeight = (newH * 56) / 100;
        const int boltTop = y + (newH * 44) / 100;
        const int boltLeft = x + (newW * 45) / 100;
        const int boltMid = x + (newW * 34) / 100;
        const int boltRight = x + (newW * 60) / 100;
        const int boltBottom = y + (newH * 88) / 100;

        drawCloudIcon(x, y, newW, cloudHeight, TFT_LIGHTGREY);
        tft.fillTriangle(boltLeft, boltTop, boltMid, y + (newH * 67) / 100, x + (newW * 49) / 100, y + (newH * 67) / 100, TFT_GOLD);
        tft.fillTriangle(x + (newW * 52) / 100, y + (newH * 54) / 100, boltRight, y + (newH * 54) / 100, x + (newW * 42) / 100, boltBottom, TFT_GOLD);
    }

    // Fixed Cloudy Icon
    const unsigned char bitmap_cloudy_64[] PROGMEM = {
        0x00, 0x00, 0x00, 0x00, 0x00, 0x00, 0x00, 0x00,
        0x00, 0x00, 0x00, 0x00, 0x00, 0x00, 0x00, 0x00,
        0x00, 0x00, 0x00, 0x00, 0x00, 0x00, 0x00, 0x00,
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        0x00, 0x00, 0x00, 0x00, 0x00, 0x00, 0x00, 0x00};

    // Fixed Rainy Icon
    const unsigned char bitmap_rainy_64[] PROGMEM = {
        0x00, 0x00, 0x00, 0x00, 0x00, 0x00, 0x00, 0x00,
        0x00, 0x00, 0x00, 0x00, 0x00, 0x00, 0x00, 0x00,
        0x00, 0x00, 0x00, 0x3F, 0xFC, 0x00, 0x00, 0x00,
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        0x00, 0x00, 0x00, 0x00, 0x00, 0x00, 0x00, 0x00};

    // Fixed Windy Icon
    const unsigned char bitmap_windy_64[] PROGMEM = {
        0x00, 0x00, 0x00, 0x00, 0x00, 0x00, 0x00, 0x00,
        0x00, 0x00, 0x00, 0x00, 0x00, 0x00, 0x00, 0x00,
        0x00, 0x7F, 0xFF, 0xFF, 0xFC, 0x00, 0x00, 0x00,
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        0x00, 0x00, 0x00, 0x00, 0x00, 0x00, 0x00, 0x00};

    // Fixed Warning / Storm Icon
    const unsigned char bitmap_warning_64[] PROGMEM = {
        0x00, 0x00, 0x00, 0x03, 0xC0, 0x00, 0x00, 0x00,
        0x00, 0x00, 0x00, 0x07, 0xE0, 0x00, 0x00, 0x00,
        0x00, 0x00, 0x00, 0x0F, 0xF0, 0x00, 0x00, 0x00,
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        0x00, 0x00, 0x00, 0x00, 0x00, 0x00, 0x00, 0x00};

    // Scaling/drawing helper: upscale 64x64 bitmaps to desired size
    // maskX/Y/W/H: optional region in source coords to suppress (set maskX<0 to disable)
    void drawScaledBitmap(int x, int y, const unsigned char *bitmap, int w, int h, int nw, int nh, uint16_t color,
                          int maskX = -1, int maskY = -1, int maskW = 0, int maskH = 0)
    {
        for (int j = 0; j < nh; ++j)
        {
            int srcY = (j * h) / nh;
            for (int i = 0; i < nw; ++i)
            {
                int srcX = (i * w) / nw;

                // If mask enabled and this source pixel falls inside, skip drawing it
                if (maskX >= 0)
                {
                    if (srcX >= maskX && srcX < (maskX + maskW) && srcY >= maskY && srcY < (maskY + maskH))
                    {
                        continue;
                    }
                }

                int byteIndex = srcY * ((w + 7) / 8) + (srcX / 8);
                int bitIndex = 7 - (srcX % 8);
                if (pgm_read_byte(&bitmap[byteIndex]) & (1 << bitIndex))
                {
                    tft.drawPixel(x + i, y + j, color);
                }
            }
        }
    }

    uint16_t getIconColor(const String &iconCode)
    {
        uint16_t color;
        if (iconCode == "01n")
        {
            color = TFT_LIGHTGREY; // Moonlit clear sky
        }
        else if (iconCode.startsWith("01"))
        {
            color = TFT_YELLOW; // Sunny
        }
        else if (iconCode.startsWith("02") || iconCode.startsWith("03") || iconCode.startsWith("04"))
        {
            color = TFT_LIGHTGREY; // Cloudy
        }
        else if (iconCode.startsWith("09") || iconCode.startsWith("10") || iconCode.startsWith("11"))
        {
            color = TFT_DARKCYAN; // Rainy
        }
        else if (iconCode.startsWith("50"))
        {
            color = TFT_CYAN; // Windy
        }
        else
        {
            color = TFT_WHITE; // Default
        }
        return color;
    }

    bool getLocalWeatherTimeInfo(long long unixTimeUtc, long long timezoneSeconds, struct tm &timeInfo)
    {
        time_t timestamp = static_cast<time_t>(unixTimeUtc + timezoneSeconds);
        struct tm *resolvedTime = gmtime(&timestamp);
        if (resolvedTime == nullptr)
        {
            return false;
        }

        timeInfo = *resolvedTime;
        return true;
    }

    bool shouldUseMoonIcon(const String &iconCode, long long unixTimeUtc, long long timezoneSeconds)
    {
        if (!iconCode.startsWith("01"))
        {
            return false;
        }

        struct tm localTimeInfo;
        if (!getLocalWeatherTimeInfo(unixTimeUtc, timezoneSeconds, localTimeInfo))
        {
            return iconCode.endsWith("n");
        }

        return localTimeInfo.tm_hour >= 18 || localTimeInfo.tm_hour < 6;
    }

    void drawWeatherIcon(int x, int y, int newW, int newH, const String &iconCode, long long unixTimeUtc, long long timezoneSeconds)
    {
        const bool useMoonIcon = shouldUseMoonIcon(iconCode, unixTimeUtc, timezoneSeconds);
        const String resolvedIconCode = useMoonIcon ? "01n" : iconCode;
        uint16_t iconColor = getIconColor(resolvedIconCode);

        if (useMoonIcon)
        {
            drawMoonIcon(x, y, newW, newH, iconColor);
            return;
        }
        else if (resolvedIconCode.startsWith("01"))
        {
            drawSunIcon(x, y, newW, newH, iconColor);
        }
        else if (resolvedIconCode.startsWith("02") || resolvedIconCode.startsWith("03") || resolvedIconCode.startsWith("04"))
        {
            drawCloudIcon(x, y, newW, newH, iconColor);
        }
        else if (resolvedIconCode.startsWith("09") || resolvedIconCode.startsWith("10"))
        {
            drawRainIcon(x, y, newW, newH, iconColor);
        }
        else if (resolvedIconCode.startsWith("50"))
        {
            drawWindIcon(x, y, newW, newH, iconColor);
        }
        else if (resolvedIconCode.startsWith("11"))
        {
            drawStormIcon(x, y, newW, newH);
        }
        else
        {
            drawCloudIcon(x, y, newW, newH, TFT_WHITE);
        }
    }

    String formatWeatherDate(long long unixTimeUtc, long long timezoneSeconds)
    {
        char buffer[48];
        struct tm timeInfo;
        if (getLocalWeatherTimeInfo(unixTimeUtc, timezoneSeconds, timeInfo))
        {
            strftime(buffer, sizeof(buffer), "%B %d, %Y", &timeInfo);
            return String(buffer);
        }
        return "N/A";
    }

    String formatWeatherTime(long long unixTimeUtc, long long timezoneSeconds)
    {
        char buffer[24];
        struct tm timeInfo;
        if (getLocalWeatherTimeInfo(unixTimeUtc, timezoneSeconds, timeInfo))
        {
            strftime(buffer, sizeof(buffer), "%I:%M:%S %p", &timeInfo);
            return String(buffer);
        }
        return "N/A";
    }
} // namespace

uint16_t getTemperatureColorCode(float temperatureF)
{
    if (temperatureF < 60.0f)
    {
        return TFT_BLUE; // Super Cold
    }
    else if (temperatureF < 70.0f)
    {
        return TFT_CYAN; // Cool
    }
    else if (temperatureF < 80.0f)
    {
        return TFT_WHITE; // Mild
    }
    else if (temperatureF < 90.0f)
    {
        return TFT_YELLOW; // Warm
    }
    else
    {
        return TFT_RED; // Hot
    }
}
bool connectToWiFi(const char *ssid, const char *password, uint8_t maxAttempts)
{
    WiFi.mode(WIFI_STA);
    WiFi.setAutoReconnect(true);
    WiFi.begin(ssid, password);

    for (uint8_t attempt = 0; attempt < maxAttempts; ++attempt)
    {
        if (WiFi.status() == WL_CONNECTED)
        {
            return true;
        }
        delay(500);
    }

    return false;
}

bool isInternetReachable(uint16_t timeoutMs)
{
    if (WiFi.status() != WL_CONNECTED)
    {
        return false;
    }

    WiFiClient probeClient;
    bool connected = probeClient.connect(kServerHost, kServerPort, timeoutMs);
    if (connected)
    {
        probeClient.stop();
    }

    return connected;
}

bool showMaxMinTemp(float currentTemp, float minTemp, float maxTemp)
{
    return (maxTemp > minTemp && (currentTemp != maxTemp != minTemp  ));
}

bool fetchWeatherData(WeatherData &data, String &statusMessage)
{
    if (WiFi.status() != WL_CONNECTED)
    {
        statusMessage = "WiFi not connected";
        return false;
    }

    WiFiClientSecure client;
    client.setInsecure();
    client.setHandshakeTimeout(30);

    HTTPClient http;
    String uri = String("/data/2.5/weather?lat=") + OPENWEATHER_LAT + "&lon=" + OPENWEATHER_LON + "&appid=" + OPENWEATHER_API_KEY + "&units=imperial";

    if (!http.begin(client, kServerHost, kServerPort, uri))
    {
        statusMessage = "HTTP init failed";
        return false;
    }

    int httpResponseCode = http.GET();
    Serial.print("HTTP Response Code: ");
    Serial.println(httpResponseCode);

    if (httpResponseCode != HTTP_CODE_OK)
    {
        statusMessage = "HTTP Error: " + String(httpResponseCode);
        http.end();
        return false;
    }

    String payload = http.getString();
    http.end();

    JsonDocument doc;
    DeserializationError error = deserializeJson(doc, payload);
    if (error)
    {
        statusMessage = "JSON Unpack Fail";
        return false;
    }

    data.city = doc["name"].as<String>();
    if (data.city.length() == 0)
    {
        data.city = "Calhoun";
    }

    data.dt = doc["dt"].as<long long>();
    data.timezoneSeconds = doc["timezone"].as<long long>();

    data.temperatureF = doc["main"]["temp"].as<float>();
    data.feelsLikeF = doc["main"]["feels_like"].as<float>();
    data.minTempF = doc["main"]["temp_min"].as<float>();
    data.maxTempF = doc["main"]["temp_max"].as<float>();
    data.humidity = doc["main"]["humidity"].as<int>();
    data.windSpeed = doc["wind"]["speed"].as<float>();

    JsonArray weatherArray = doc["weather"].as<JsonArray>();
    if (weatherArray.size() > 0)
    {
        data.description = weatherArray[0]["description"].as<String>();
        data.iconCode = weatherArray[0]["icon"].as<String>();
    }
    else
    {
        data.description = "CLOUDY";
        data.iconCode = "01d";
    }

    data.description.toUpperCase();
    statusMessage = "";
    return true;
}

void renderWeatherUI(const WeatherData &data)
{
    tft.fillScreen(TFT_BLACK);

    tft.setTextColor(TFT_CYAN, TFT_BLACK);
    tft.setTextSize(2);
    tft.setTextDatum(TL_DATUM);
    tft.drawString(data.city, 15, 15);

    tft.setTextColor(TFT_CYAN, TFT_BLACK);
    tft.setTextSize(2);
    tft.setTextDatum(TR_DATUM);
    tft.drawString(formatWeatherDate(data.dt, data.timezoneSeconds), 305, 15);
    tft.setTextDatum(TL_DATUM);
    tft.drawFastHLine(15, 42, 290, TFT_DARKGREY);
    tft.setTextColor(TFT_CYAN, TFT_BLACK);
    tft.setTextSize(2);
    tft.setTextDatum(TR_DATUM);
    tft.drawString(formatWeatherTime(data.dt, data.timezoneSeconds), 305, 48);
    tft.setTextDatum(TL_DATUM);

    tft.setTextColor(getTemperatureColorCode(data.temperatureF), TFT_BLACK);
    tft.setTextSize(4);
    tft.drawString(String((int)data.temperatureF) + " F", 15, 55);

    const int moveUpDown = showMaxMinTemp(data.temperatureF, data.minTempF, data.maxTempF) ? 0 : 20;
    if (moveUpDown == 0)
    {
        tft.setTextColor(TFT_CYAN, TFT_BLACK);
        tft.setTextSize(2);
        tft.drawString("Min: " + String((int)data.minTempF) + " / Max: " + String((int)data.maxTempF), 15, 95);
    }

    tft.setTextColor(TFT_WHITE, TFT_BLACK);
    tft.setTextSize(data.description.length() > 17 ? 2 : 3);
    tft.drawString(data.description, 15, 125 - moveUpDown);

    tft.setTextColor(TFT_GOLD, TFT_BLACK);
    tft.setTextSize(2);
    tft.drawString("Feels like: " + String((int)data.feelsLikeF) + " F", 15, 165 - moveUpDown);

    tft.setTextColor(TFT_GREEN, TFT_BLACK);
    tft.drawString("Humidity: " + String(data.humidity) + "%", 15, 190 - moveUpDown);
    tft.drawString("Wind: " + String(data.windSpeed) + " mph", 15, 215 - moveUpDown);

    drawWeatherIcon(216, 140 - moveUpDown, 96, 96, data.iconCode, data.dt, data.timezoneSeconds);
}

namespace
{
    void drawStatusMessage(const String &message, uint16_t color, bool center)
    {
        tft.fillScreen(TFT_BLACK);
        tft.setTextColor(color, TFT_BLACK);
        tft.setTextSize(2);

        if (center)
        {
            tft.setTextDatum(MC_DATUM);
            tft.drawString(message, 160, 120);
        }
        else
        {
            tft.setTextDatum(TL_DATUM);
            tft.drawString(message, 20, 100);
        }

        Serial.println(message);
    }
}

void displayStatusMessage(const String &message, uint16_t color)
{
    drawStatusMessage(message, color, false);
}

void displayCenteredStatusMessage(const String &message, uint16_t color)
{
    drawStatusMessage(message, color, true);
}
